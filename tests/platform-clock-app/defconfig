## tests/platform-clock-app/defconfig
```kconfig
CONFIG_ARCH_ARM_64=y
CONFIG_LIBPOSIX_ENVIRON_LIBPARAM=y
CONFIG_PLAT_KVM=y
CONFIG_KVM_VMM_QEMU=y
CONFIG_KVM_BOOT_PROTO_LXBOOT=y
# CONFIG_LIBUKINTCTLR_GICV2 is not set
CONFIG_LIBUKINTCTLR_GICV3=y
CONFIG_LIBUKRANDOM=y
CONFIG_LIBUKRANDOM_DTB_SEED=y
CONFIG_LIBUKRANDOM_GETRANDOM=y
# CONFIG_LIBUKRANDOM_LCPU is not set
CONFIG_LIBUKPRINT_KLVL_INFO=y
CONFIG_LIBUKBOOT_BANNER_MINIMAL=y
CONFIG_LIBMUSL=y
CONFIG_LIBLWIP=y
CONFIG_LIBUKNETDEV_EINFO_LIBPARAM=y
CONFIG_LWIP_THREADS=y
CONFIG_LWIP_SOCKET=y
CONFIG_LWIP_IPV4=y
CONFIG_LWIP_IPV6=y
CONFIG_LWIP_DHCP=y
CONFIG_LWIP_WAITIFACE=y
CONFIG_LWIP_WAITIFACE_TO=10
CONFIG_LIBPOSIX_TIME=y
CONFIG_LIBPOSIX_POLL=y
CONFIG_LIBPOSIX_TTY=y
CONFIG_LIBPOSIX_TTY_STDIO=y
CONFIG_LIBPOSIX_TTY_STDOUT_SERIAL=y

CONFIG_LIBNGHTTP3=y
CONFIG_LIBNGTCP2=y
CONFIG_LIBOPENSSL=y
CONFIG_LIBSSL=y
CONFIG_LIBNGTCP2_CRYPTO_OSSL=y

CONFIG_LIBPOSIX_VFS_FSTAB=y
CONFIG_LIBPOSIX_VFS_FSTAB_BUILTIN=y
CONFIG_LIBPOSIX_VFS_FSTAB_BUILTIN_INITRD=y

# CONFIG_ARM64_ERRATUM_843419 is not set
CONFIG_LIBCXX=y
CONFIG_LIBCXX_RELEASE2118=y
CONFIG_LIBCXXABI_RELEASE2118=y
CONFIG_LIBUNWIND_RELEASE2118=y
CONFIG_CXX_THREADS=y
CONFIG_LIBCXXABI_THREADS=y
CONFIG_LIBPOSIX_PIPE=y
CONFIG_LIBPOSIX_UNIXSOCKET=y
CONFIG_LIBNGHTTP2=y
CONFIG_LIBCARES=y
CONFIG_LIBZLIB=y
CONFIG_LIBEV=y

CONFIG_LIBNGHTTPX=y
CONFIG_LIBEV_EPOLL=y
CONFIG_LWIP_PINNED22X=y
CONFIG_LWIP_NETBUF_RECVINFO=y
CONFIG_LWIP_UKNETDEV_DEFER_STATUS_RX=y
CONFIG_LWIP_TCP_ACK_DELAY_MS=50

CONFIG_APPNGHTTPX_BOOT_EPOCH=y
CONFIG_APPNGHTTPX_CONTROL=y
CONFIG_APPNGHTTPX_STATS=y
CONFIG_APPNGHTTPX_IPV6=y
# CONFIG_APPNGHTTPX_BOOT_EPOCH is not set
# CONFIG_APPNGHTTPX_CONTROL is not set
# CONFIG_APPNGHTTPX_STATS is not set
# CONFIG_APPNGHTTPX_FD_STATS is not set
```

## tests/socket-contracts/defconfig
```kconfig
CONFIG_ARCH_ARM_64=y
CONFIG_PLAT_KVM=y
CONFIG_KVM_VMM_QEMU=y
CONFIG_KVM_BOOT_PROTO_QEMU_VIRT=y
# CONFIG_LIBUKINTCTLR_GICV2 is not set
CONFIG_LIBUKINTCTLR_GICV3=y
CONFIG_LIBUKRANDOM=y
CONFIG_LIBUKRANDOM_DTB_SEED=y
# CONFIG_LIBUKRANDOM_LCPU is not set
CONFIG_LIBUKPRINT_KLVL_INFO=y
CONFIG_LIBUKBOOT_BANNER_MINIMAL=y
CONFIG_LIBMUSL=y
CONFIG_LIBPOSIX_TIME=y
CONFIG_LIBPOSIX_POLL=y
CONFIG_LIBPOSIX_TTY=y
CONFIG_LIBPOSIX_TTY_STDIO=y
CONFIG_LIBPOSIX_TTY_STDOUT_SERIAL=y
CONFIG_LIBLWIP=y
CONFIG_LWIP_PINNED22X=y
CONFIG_LWIP_THREADS=y
CONFIG_LWIP_SOCKET=y
CONFIG_LWIP_IPV4=y
CONFIG_LWIP_IPV6=y
# CONFIG_LWIP_AUTOIFACE is not set
# CONFIG_LWIP_DHCP is not set
# CONFIG_LWIP_WAITIFACE is not set

CONFIG_LIBPOSIX_VFS_FSTAB=y
CONFIG_LIBPOSIX_VFS_FSTAB_BUILTIN=y
CONFIG_LIBPOSIX_VFS_FSTAB_BUILTIN_RAMFS=y

# CONFIG_ARM64_ERRATUM_843419 is not set
```
